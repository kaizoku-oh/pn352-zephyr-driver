## CMakeLists.txt
```
# Copyright (c) 2025 Bayrem Gharsellaoui
# SPDX-License-Identifier: Apache-2.0

cmake_minimum_required(VERSION 3.20.0)

find_package(Zephyr REQUIRED HINTS $ENV{ZEPHYR_BASE})
project(pn532)

include_directories(../../../include/zephyr/drivers/pn532)

target_sources(app PRIVATE src/main.c)
```

## prj.conf
```kconfig
# Copyright (c) 2025 Bayrem Gharsellaoui
# SPDX-License-Identifier: Apache-2.0

# Test
CONFIG_TEST=y
CONFIG_ZTEST=y
CONFIG_ZTEST_NEW_API=y

# PN532 NFC module
CONFIG_I2C=y
CONFIG_PN532=y
CONFIG_PN532_LOG_LEVEL=4
```

## src/main.c
```c
/*
 * Copyright (c) 2025 Bayrem Gharsellaoui
 * SPDX-License-Identifier: Apache-2.0
 */

#include <zephyr/kernel.h>
#include <zephyr/device.h>
#include <zephyr/ztest.h>

#include "pn532.h"

ZTEST_SUITE(pn532, NULL, NULL, NULL, NULL, NULL);

/**
 * @brief Test firmware version retrieval for the PN532 driver
 */
ZTEST(pn532, test_get_firmware_version)
{
    uint32_t version = 0;
    const struct device *dev = DEVICE_DT_GET_ONE(nxp_pn532);

    zassert_equal(EINVAL, pn532_get_firmware_version(NULL, NULL));
    zassert_equal(EINVAL, pn532_get_firmware_version(dev, NULL));
    zassert_equal(EINVAL, pn532_get_firmware_version(NULL, &version));
    zassert_equal(0, pn532_get_firmware_version(dev, &version));
    zassert_equal(0x01020304, version);
}
```
