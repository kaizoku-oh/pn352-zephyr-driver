## Kconfig
```kconfig
# Copyright (c) 2025 Bayrem Gharsellaoui
# SPDX-License-Identifier: Apache-2.0

rsource "drivers/Kconfig"
```

## drivers/nfc/pn532/Kconfig
```kconfig
# Defining Kconfig options for PN532 driver
config NFC_PN532
    bool "PN532 NFC Driver"
    help
      Enable support for NXP PN532 NFC module.

choice PN532_TRANSPORT
    prompt "PN532 Transport"
    depends on NFC_PN532
    help
      Select the transport protocol for the PN532 NFC module.

config PN532_I2C
    bool "I2C"
    depends on I2C
    help
      Use I2C transport for PN532.

config PN532_SPI
    bool "SPI"
    depends on SPI
    help
      Use SPI transport for PN532.

config PN532_UART
    bool "UART"
    depends on UART
    help
      Use UART transport for PN532.
endchoice
```

## drivers/pn532/Kconfig
```kconfig
# Copyright (c) 2025 Bayrem Gharsellaoui
# SPDX-License-Identifier: Apache-2.0

menuconfig PN532
	bool "PN532 device drivers"
	help
	  This option enables the pn532 custom driver class.

if PN532

config PN532_INIT_PRIORITY
	int "PN532 device drivers init priority"
	default KERNEL_INIT_PRIORITY_DEVICE
	help
	  PN532 device drivers init priority.

module = PN532
module-str = pn532
source "subsys/logging/Kconfig.template.log_config"

endif # PN532
```

## dts/bindings/nfc/nxp,pn532.yaml
```yaml
# Defining the device tree binding for the PN532 NFC module
compatible: "nxp,pn532"
include: [i2c-device.yaml, spi-device.yaml, uart-device.yaml]
properties:
  reg:
    type: int
    required: true
    description: I2C or SPI device address
  label:
    type: string
    required: true
    description: Human-readable device label
  cs-gpios:
    type: phandle-array
    required: false
    description: Chip select GPIO for SPI
```

## dts/bindings/nxp,pn532-i2c.yaml
```yaml
compatible: "nxp,pn532-i2c"
include: ["i2c-device.yaml"]
properties:
  label:
    required: true
```

## dts/bindings/nxp,pn532-spi.yaml
```yaml
compatible: "nxp,pn532-spi"
include: ["spi-device.yaml"]
properties:
  label:
    required: true
```

## dts/bindings/nxp,pn532-uart.yaml
```yaml
compatible: "nxp,pn532-uart"
include: ["uart-device.yaml"]
properties:
  label:
    required: true
```

## dts/bindings/sensor/nxp,pn532.yaml
```yaml
description: |
  PN532 NFC module driver dts binding

compatible: "nxp,pn532"

include: [base.yaml, i2c-device.yaml]
```

## samples/pn532/basic/west.yml
```yaml
# Copyright (c) 2025 Bayrem Gharsellaoui
# SPDX-License-Identifier: Apache-2.0

manifest:
  version: "0.11"

  projects:
    - name: zephyr
      url: https://github.com/zephyrproject-rtos/zephyr
      revision: main
      import:
        name-allowlist:
          - cmsis
          - hal_stm32

  self:
    # Relative path from `samples/pn532/basic` to the repo root
    path: ../../../
```

## tests/drivers/pn532/testcase.yaml
```yaml
# Copyright (c) 2025 Bayrem Gharsellaoui
# SPDX-License-Identifier: Apache-2.0

tests:
  driver.pn532:
    build_only: true
    platform_allow:
      - native_sim
    integration_platforms:
      - native_sim
    tags:
      - drivers
      - pn532
    extra_configs:
      - CONFIG_PN532_TRANSPORT_MOCK=y
```

## tests/unit/pn532/testcase.yaml
```yaml
# Copyright (c) 2025 Bayrem Gharsellaoui
# SPDX-License-Identifier: Apache-2.0

tests:
  pn532.driver.unit:
    platform_allow:
      - native_sim
    integration_platforms:
      - native_sim
    tags:
      - pn532
    extra_configs:
      - CONFIG_TEST=y
      - CONFIG_PN532_TRANSPORT_MOCK=y
```

## tests/unit/testcase.yaml
```yaml
tests:
  drivers.pn532:
  integration_platforms:
    - native_sim
  tags:
    - pn532
  type: unit
```

## west.yml
```yaml
# Copyright (c) 2025 Bayrem Gharsellaoui
# SPDX-License-Identifier: Apache-2.0

manifest:

  projects:
    - name: zephyr
      url: https://github.com/zephyrproject-rtos/zephyr
      revision: v4.1.0
      import:
        name-allowlist:
          - cmsis
          - hal_stm32

  self:
    path: pn532-zephyr-driver
```
