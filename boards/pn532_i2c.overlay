/ {
    pn532: pn532@24 {
        compatible = "nxp,pn532";
        status = "okay";
        reg = <0x24>;
        i2c = <&i2c1>;
        label = "PN532_I2C";
    };
};

&i2c1 {
    status = "okay";
    pinctrl-0 = <&i2c1_scl_pb8 &i2c1_sda_pb9>;
    pinctrl-names = "default";
};