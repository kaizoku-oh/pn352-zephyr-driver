/ {
    pn532: pn532@0 {
        compatible = "nxp,pn532";
        status = "okay";
        reg = <0>;
        uart = <&usart2>;
        label = "PN532_UART";
    };
};

&usart2 {
    status = "okay";
    pinctrl-0 = <&usart2_tx_pa2 &usart2_rx_pa3>;
    pinctrl-names = "default";
};